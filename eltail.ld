SECTIONS
{
    __romPos = 0;
    _gp = 0x0;
    header_ROM_START = __romPos;
    header_VRAM = ADDR(.header);
    .header : AT(header_ROM_START) SUBALIGN(16)
    {
        header_DATA_START = .;
        header_s = .;
        build/asm/header.s.o(.data);
        header_DATA_END = .;
        header_DATA_SIZE = ABSOLUTE(header_DATA_END - header_DATA_START);
    }
    __romPos += SIZEOF(.header);
    header_ROM_END = __romPos;
    header_VRAM_END = .;

    boot_ROM_START = __romPos;
    boot_VRAM = ADDR(.boot);
    .boot : AT(boot_ROM_START) SUBALIGN(16)
    {
        boot_DATA_START = .;
        boot_bin = .;
        build/assets/boot.bin.o(.data);
        boot_DATA_END = .;
        boot_DATA_SIZE = ABSOLUTE(boot_DATA_END - boot_DATA_START);
    }
    __romPos += SIZEOF(.boot);
    boot_ROM_END = __romPos;
    boot_VRAM_END = .;

    main_ROM_START = __romPos;
    main_VRAM = ADDR(.main);
    .main 0x80000400 : AT(main_ROM_START) SUBALIGN(16)
    {
        main_TEXT_START = .;
        build/src/1000.c.o(.text);
        build/src/1130.c.o(.text);
        build/src/1870.c.o(.text);
        build/src/3B40.c.o(.text);
        build/src/3F50.c.o(.text);
        build/src/9D50.c.o(.text);
        build/src/DAE0.c.o(.text);
        build/src/E2A0.c.o(.text);
        build/src/113F0.c.o(.text);
        build/src/13DE0.c.o(.text);
        build/src/140D0.c.o(.text);
        build/src/15150.c.o(.text);
        build/src/17360.c.o(.text);
        build/src/1B200.c.o(.text);
        build/src/1E570.c.o(.text);
        build/src/1FA00.c.o(.text);
        build/src/20DA0.c.o(.text);
        build/src/216E0.c.o(.text);
        build/src/272D0.c.o(.text);
        build/src/27600.c.o(.text);
        build/src/27A90.c.o(.text);
        build/src/28D20.c.o(.text);
        build/src/29150.c.o(.text);
        build/src/2B0F0.c.o(.text);
        build/src/337B0.c.o(.text);
        build/src/35EC0.c.o(.text);
        build/src/363B0.c.o(.text);
        build/src/36DB0.c.o(.text);
        build/src/36E60.c.o(.text);
        build/src/376C0.c.o(.text);
        build/src/37980.c.o(.text);
        build/src/37AD0.c.o(.text);
        build/src/37E40.c.o(.text);
        build/asm/37EB0.s.o(.text);
        build/asm/37F20.s.o(.text);
        build/asm/38060.s.o(.text);
        build/asm/382C0.s.o(.text);
        build/asm/382F0.s.o(.text);
        build/asm/38680.s.o(.text);
        build/asm/38770.s.o(.text);
        build/asm/38A80.s.o(.text);
        build/asm/38AF0.s.o(.text);
        build/asm/38CB0.s.o(.text);
        build/asm/38D30.s.o(.text);
        build/asm/38DB0.s.o(.text);
        build/asm/38E40.s.o(.text);
        build/asm/39110.s.o(.text);
        build/asm/39330.s.o(.text);
        build/asm/39610.s.o(.text);
        build/asm/39820.s.o(.text);
        build/asm/39BA0.s.o(.text);
        build/asm/39E30.s.o(.text);
        build/asm/3A2C0.s.o(.text);
        build/asm/3A360.s.o(.text);
        build/asm/3A4D0.s.o(.text);
        build/asm/3A550.s.o(.text);
        build/asm/3A5D0.s.o(.text);
        build/asm/3A680.s.o(.text);
        build/asm/3A790.s.o(.text);
        build/asm/3A7D0.s.o(.text);
        build/asm/3A830.s.o(.text);
        build/asm/3A980.s.o(.text);
        build/asm/3AA80.s.o(.text);
        build/asm/3B170.s.o(.text);
        build/asm/3B220.s.o(.text);
        build/asm/3B230.s.o(.text);
        build/asm/3C460.s.o(.text);
        build/asm/3C6B0.s.o(.text);
        build/asm/3C6F0.s.o(.text);
        build/asm/3D1B0.s.o(.text);
        build/asm/3D1F0.s.o(.text);
        build/asm/3D280.s.o(.text);
        build/asm/3D2C0.s.o(.text);
        build/asm/3D9D0.s.o(.text);
        build/asm/3DA70.s.o(.text);
        build/asm/3DA90.s.o(.text);
        build/asm/3DB20.s.o(.text);
        build/asm/3DB80.s.o(.text);
        build/asm/3DBD0.s.o(.text);
        build/asm/3DC30.s.o(.text);
        build/asm/3DC90.s.o(.text);
        build/asm/3DCF0.s.o(.text);
        build/asm/3E4D0.s.o(.text);
        build/asm/3E510.s.o(.text);
        build/asm/3E850.s.o(.text);
        build/asm/3E8C0.s.o(.text);
        build/asm/3EAA0.s.o(.text);
        build/asm/3EC80.s.o(.text);
        build/asm/3EE20.s.o(.text);
        build/asm/3F2A0.s.o(.text);
        build/asm/3F510.s.o(.text);
        build/asm/3F960.s.o(.text);
        build/asm/3F9C0.s.o(.text);
        build/asm/3FB90.s.o(.text);
        build/asm/3FBB0.s.o(.text);
        build/asm/3FC60.s.o(.text);
        build/asm/405B0.s.o(.text);
        build/asm/40610.s.o(.text);
        build/asm/40670.s.o(.text);
        build/asm/40710.s.o(.text);
        build/asm/40750.s.o(.text);
        build/asm/40870.s.o(.text);
        build/asm/40C60.s.o(.text);
        build/asm/41230.s.o(.text);
        build/asm/41240.s.o(.text);
        build/asm/41250.s.o(.text);
        build/asm/415A0.s.o(.text);
        build/asm/41630.s.o(.text);
        build/asm/41660.s.o(.text);
        build/asm/41A70.s.o(.text);
        build/asm/41D70.s.o(.text);
        build/asm/41D80.s.o(.text);
        build/asm/41E40.s.o(.text);
        build/asm/42B00.s.o(.text);
        build/asm/42BA0.s.o(.text);
        build/asm/42D20.s.o(.text);
        build/asm/42D30.s.o(.text);
        build/asm/43810.s.o(.text);
        build/asm/438B0.s.o(.text);
        build/asm/44550.s.o(.text);
        build/asm/44850.s.o(.text);
        build/asm/454B0.s.o(.text);
        build/asm/455C0.s.o(.text);
        build/asm/46FF0.s.o(.text);
        build/asm/470C0.s.o(.text);
        build/asm/47210.s.o(.text);
        build/asm/472A0.s.o(.text);
        build/asm/474D0.s.o(.text);
        build/asm/47610.s.o(.text);
        build/asm/476A0.s.o(.text);
        build/asm/47740.s.o(.text);
        build/asm/477D0.s.o(.text);
        build/asm/47AC0.s.o(.text);
        build/asm/47B40.s.o(.text);
        build/asm/47D70.s.o(.text);
        build/asm/488F0.s.o(.text);
        build/asm/49340.s.o(.text);
        build/asm/494B0.s.o(.text);
        build/asm/49700.s.o(.text);
        build/asm/497E0.s.o(.text);
        build/asm/49990.s.o(.text);
        build/asm/499C0.s.o(.text);
        build/asm/49AD0.s.o(.text);
        build/asm/49B30.s.o(.text);
        build/asm/49E60.s.o(.text);
        build/asm/49EB0.s.o(.text);
        build/asm/49F00.s.o(.text);
        build/asm/49F10.s.o(.text);
        build/asm/4A1B0.s.o(.text);
        build/asm/4AC70.s.o(.text);
        build/asm/4ACF0.s.o(.text);
        build/asm/4AD10.s.o(.text);
        build/asm/4B960.s.o(.text);
        build/asm/4C3F0.s.o(.text);
        main_TEXT_END = .;
        main_TEXT_SIZE = ABSOLUTE(main_TEXT_END - main_TEXT_START);
        main_DATA_START = .;
        _4C580_bin = .;
        build/assets/4C580.bin.o(.data);
        _1000_c = .;
        build/src/1000.c.o(.data);
        _1130_c = .;
        build/src/1130.c.o(.data);
        _1870_c = .;
        build/src/1870.c.o(.data);
        _3B40_c = .;
        build/src/3B40.c.o(.data);
        _3F50_c = .;
        build/src/3F50.c.o(.data);
        _9D50_c = .;
        build/src/9D50.c.o(.data);
        DAE0_c = .;
        build/src/DAE0.c.o(.data);
        E2A0_c = .;
        build/src/E2A0.c.o(.data);
        _113F0_c = .;
        build/src/113F0.c.o(.data);
        _13DE0_c = .;
        build/src/13DE0.c.o(.data);
        _140D0_c = .;
        build/src/140D0.c.o(.data);
        _15150_c = .;
        build/src/15150.c.o(.data);
        _17360_c = .;
        build/src/17360.c.o(.data);
        _1B200_c = .;
        build/src/1B200.c.o(.data);
        _1E570_c = .;
        build/src/1E570.c.o(.data);
        _1FA00_c = .;
        build/src/1FA00.c.o(.data);
        _20DA0_c = .;
        build/src/20DA0.c.o(.data);
        _216E0_c = .;
        build/src/216E0.c.o(.data);
        _272D0_c = .;
        build/src/272D0.c.o(.data);
        _27600_c = .;
        build/src/27600.c.o(.data);
        _27A90_c = .;
        build/src/27A90.c.o(.data);
        _28D20_c = .;
        build/src/28D20.c.o(.data);
        _29150_c = .;
        build/src/29150.c.o(.data);
        _2B0F0_c = .;
        build/src/2B0F0.c.o(.data);
        _337B0_c = .;
        build/src/337B0.c.o(.data);
        _35EC0_c = .;
        build/src/35EC0.c.o(.data);
        _363B0_c = .;
        build/src/363B0.c.o(.data);
        _36DB0_c = .;
        build/src/36DB0.c.o(.data);
        _36E60_c = .;
        build/src/36E60.c.o(.data);
        _376C0_c = .;
        build/src/376C0.c.o(.data);
        _37980_c = .;
        build/src/37980.c.o(.data);
        _37AD0_c = .;
        build/src/37AD0.c.o(.data);
        _37E40_c = .;
        build/src/37E40.c.o(.data);
        _37EB0_s = .;
        build/asm/37EB0.s.o(.data);
        _37F20_s = .;
        build/asm/37F20.s.o(.data);
        _38060_s = .;
        build/asm/38060.s.o(.data);
        _382C0_s = .;
        build/asm/382C0.s.o(.data);
        _382F0_s = .;
        build/asm/382F0.s.o(.data);
        _38680_s = .;
        build/asm/38680.s.o(.data);
        _38770_s = .;
        build/asm/38770.s.o(.data);
        _38A80_s = .;
        build/asm/38A80.s.o(.data);
        _38AF0_s = .;
        build/asm/38AF0.s.o(.data);
        _38CB0_s = .;
        build/asm/38CB0.s.o(.data);
        _38D30_s = .;
        build/asm/38D30.s.o(.data);
        _38DB0_s = .;
        build/asm/38DB0.s.o(.data);
        _38E40_s = .;
        build/asm/38E40.s.o(.data);
        _39110_s = .;
        build/asm/39110.s.o(.data);
        _39330_s = .;
        build/asm/39330.s.o(.data);
        _39610_s = .;
        build/asm/39610.s.o(.data);
        _39820_s = .;
        build/asm/39820.s.o(.data);
        _39BA0_s = .;
        build/asm/39BA0.s.o(.data);
        _39E30_s = .;
        build/asm/39E30.s.o(.data);
        _3A2C0_s = .;
        build/asm/3A2C0.s.o(.data);
        _3A360_s = .;
        build/asm/3A360.s.o(.data);
        _3A4D0_s = .;
        build/asm/3A4D0.s.o(.data);
        _3A550_s = .;
        build/asm/3A550.s.o(.data);
        _3A5D0_s = .;
        build/asm/3A5D0.s.o(.data);
        _3A680_s = .;
        build/asm/3A680.s.o(.data);
        _3A790_s = .;
        build/asm/3A790.s.o(.data);
        _3A7D0_s = .;
        build/asm/3A7D0.s.o(.data);
        _3A830_s = .;
        build/asm/3A830.s.o(.data);
        _3A980_s = .;
        build/asm/3A980.s.o(.data);
        _3AA80_s = .;
        build/asm/3AA80.s.o(.data);
        _3B170_s = .;
        build/asm/3B170.s.o(.data);
        _3B220_s = .;
        build/asm/3B220.s.o(.data);
        _3B230_s = .;
        build/asm/3B230.s.o(.data);
        _3C460_s = .;
        build/asm/3C460.s.o(.data);
        _3C6B0_s = .;
        build/asm/3C6B0.s.o(.data);
        _3C6F0_s = .;
        build/asm/3C6F0.s.o(.data);
        _3D1B0_s = .;
        build/asm/3D1B0.s.o(.data);
        _3D1F0_s = .;
        build/asm/3D1F0.s.o(.data);
        _3D280_s = .;
        build/asm/3D280.s.o(.data);
        _3D2C0_s = .;
        build/asm/3D2C0.s.o(.data);
        _3D9D0_s = .;
        build/asm/3D9D0.s.o(.data);
        _3DA70_s = .;
        build/asm/3DA70.s.o(.data);
        _3DA90_s = .;
        build/asm/3DA90.s.o(.data);
        _3DB20_s = .;
        build/asm/3DB20.s.o(.data);
        _3DB80_s = .;
        build/asm/3DB80.s.o(.data);
        _3DBD0_s = .;
        build/asm/3DBD0.s.o(.data);
        _3DC30_s = .;
        build/asm/3DC30.s.o(.data);
        _3DC90_s = .;
        build/asm/3DC90.s.o(.data);
        _3DCF0_s = .;
        build/asm/3DCF0.s.o(.data);
        _3E4D0_s = .;
        build/asm/3E4D0.s.o(.data);
        _3E510_s = .;
        build/asm/3E510.s.o(.data);
        _3E850_s = .;
        build/asm/3E850.s.o(.data);
        _3E8C0_s = .;
        build/asm/3E8C0.s.o(.data);
        _3EAA0_s = .;
        build/asm/3EAA0.s.o(.data);
        _3EC80_s = .;
        build/asm/3EC80.s.o(.data);
        _3EE20_s = .;
        build/asm/3EE20.s.o(.data);
        _3F2A0_s = .;
        build/asm/3F2A0.s.o(.data);
        _3F510_s = .;
        build/asm/3F510.s.o(.data);
        _3F960_s = .;
        build/asm/3F960.s.o(.data);
        _3F9C0_s = .;
        build/asm/3F9C0.s.o(.data);
        _3FB90_s = .;
        build/asm/3FB90.s.o(.data);
        _3FBB0_s = .;
        build/asm/3FBB0.s.o(.data);
        _3FC60_s = .;
        build/asm/3FC60.s.o(.data);
        _405B0_s = .;
        build/asm/405B0.s.o(.data);
        _40610_s = .;
        build/asm/40610.s.o(.data);
        _40670_s = .;
        build/asm/40670.s.o(.data);
        _40710_s = .;
        build/asm/40710.s.o(.data);
        _40750_s = .;
        build/asm/40750.s.o(.data);
        _40870_s = .;
        build/asm/40870.s.o(.data);
        _40C60_s = .;
        build/asm/40C60.s.o(.data);
        _41230_s = .;
        build/asm/41230.s.o(.data);
        _41240_s = .;
        build/asm/41240.s.o(.data);
        _41250_s = .;
        build/asm/41250.s.o(.data);
        _415A0_s = .;
        build/asm/415A0.s.o(.data);
        _41630_s = .;
        build/asm/41630.s.o(.data);
        _41660_s = .;
        build/asm/41660.s.o(.data);
        _41A70_s = .;
        build/asm/41A70.s.o(.data);
        _41D70_s = .;
        build/asm/41D70.s.o(.data);
        _41D80_s = .;
        build/asm/41D80.s.o(.data);
        _41E40_s = .;
        build/asm/41E40.s.o(.data);
        _42B00_s = .;
        build/asm/42B00.s.o(.data);
        _42BA0_s = .;
        build/asm/42BA0.s.o(.data);
        _42D20_s = .;
        build/asm/42D20.s.o(.data);
        _42D30_s = .;
        build/asm/42D30.s.o(.data);
        _43810_s = .;
        build/asm/43810.s.o(.data);
        _438B0_s = .;
        build/asm/438B0.s.o(.data);
        _44550_s = .;
        build/asm/44550.s.o(.data);
        _44850_s = .;
        build/asm/44850.s.o(.data);
        _454B0_s = .;
        build/asm/454B0.s.o(.data);
        _455C0_s = .;
        build/asm/455C0.s.o(.data);
        _46FF0_s = .;
        build/asm/46FF0.s.o(.data);
        _470C0_s = .;
        build/asm/470C0.s.o(.data);
        _47210_s = .;
        build/asm/47210.s.o(.data);
        _472A0_s = .;
        build/asm/472A0.s.o(.data);
        _474D0_s = .;
        build/asm/474D0.s.o(.data);
        _47610_s = .;
        build/asm/47610.s.o(.data);
        _476A0_s = .;
        build/asm/476A0.s.o(.data);
        _47740_s = .;
        build/asm/47740.s.o(.data);
        _477D0_s = .;
        build/asm/477D0.s.o(.data);
        _47AC0_s = .;
        build/asm/47AC0.s.o(.data);
        _47B40_s = .;
        build/asm/47B40.s.o(.data);
        _47D70_s = .;
        build/asm/47D70.s.o(.data);
        _488F0_s = .;
        build/asm/488F0.s.o(.data);
        _49340_s = .;
        build/asm/49340.s.o(.data);
        _494B0_s = .;
        build/asm/494B0.s.o(.data);
        _49700_s = .;
        build/asm/49700.s.o(.data);
        _497E0_s = .;
        build/asm/497E0.s.o(.data);
        _49990_s = .;
        build/asm/49990.s.o(.data);
        _499C0_s = .;
        build/asm/499C0.s.o(.data);
        _49AD0_s = .;
        build/asm/49AD0.s.o(.data);
        _49B30_s = .;
        build/asm/49B30.s.o(.data);
        _49E60_s = .;
        build/asm/49E60.s.o(.data);
        _49EB0_s = .;
        build/asm/49EB0.s.o(.data);
        _49F00_s = .;
        build/asm/49F00.s.o(.data);
        _49F10_s = .;
        build/asm/49F10.s.o(.data);
        _4A1B0_s = .;
        build/asm/4A1B0.s.o(.data);
        _4AC70_s = .;
        build/asm/4AC70.s.o(.data);
        _4ACF0_s = .;
        build/asm/4ACF0.s.o(.data);
        _4AD10_s = .;
        build/asm/4AD10.s.o(.data);
        _4B960_s = .;
        build/asm/4B960.s.o(.data);
        _4C3F0_s = .;
        build/asm/4C3F0.s.o(.data);
        main_DATA_END = .;
        main_DATA_SIZE = ABSOLUTE(main_DATA_END - main_DATA_START);
        main_RODATA_START = .;
        build/src/1000.c.o(.rodata);
        build/src/1130.c.o(.rodata);
        build/src/1870.c.o(.rodata);
        build/src/3B40.c.o(.rodata);
        build/src/3F50.c.o(.rodata);
        build/src/9D50.c.o(.rodata);
        build/src/DAE0.c.o(.rodata);
        build/src/E2A0.c.o(.rodata);
        build/src/113F0.c.o(.rodata);
        build/src/13DE0.c.o(.rodata);
        build/src/140D0.c.o(.rodata);
        build/src/15150.c.o(.rodata);
        build/src/17360.c.o(.rodata);
        build/src/1B200.c.o(.rodata);
        build/src/1E570.c.o(.rodata);
        build/src/1FA00.c.o(.rodata);
        build/src/20DA0.c.o(.rodata);
        build/src/216E0.c.o(.rodata);
        build/src/272D0.c.o(.rodata);
        build/src/27600.c.o(.rodata);
        build/src/27A90.c.o(.rodata);
        build/src/28D20.c.o(.rodata);
        build/src/29150.c.o(.rodata);
        build/src/2B0F0.c.o(.rodata);
        build/src/337B0.c.o(.rodata);
        build/src/35EC0.c.o(.rodata);
        build/src/363B0.c.o(.rodata);
        build/src/36DB0.c.o(.rodata);
        build/src/36E60.c.o(.rodata);
        build/src/376C0.c.o(.rodata);
        build/src/37980.c.o(.rodata);
        build/src/37AD0.c.o(.rodata);
        build/src/37E40.c.o(.rodata);
        build/asm/37EB0.s.o(.rodata);
        build/asm/37F20.s.o(.rodata);
        build/asm/38060.s.o(.rodata);
        build/asm/382C0.s.o(.rodata);
        build/asm/382F0.s.o(.rodata);
        build/asm/38680.s.o(.rodata);
        build/asm/38770.s.o(.rodata);
        build/asm/38A80.s.o(.rodata);
        build/asm/38AF0.s.o(.rodata);
        build/asm/38CB0.s.o(.rodata);
        build/asm/38D30.s.o(.rodata);
        build/asm/38DB0.s.o(.rodata);
        build/asm/38E40.s.o(.rodata);
        build/asm/39110.s.o(.rodata);
        build/asm/39330.s.o(.rodata);
        build/asm/39610.s.o(.rodata);
        build/asm/39820.s.o(.rodata);
        build/asm/39BA0.s.o(.rodata);
        build/asm/39E30.s.o(.rodata);
        build/asm/3A2C0.s.o(.rodata);
        build/asm/3A360.s.o(.rodata);
        build/asm/3A4D0.s.o(.rodata);
        build/asm/3A550.s.o(.rodata);
        build/asm/3A5D0.s.o(.rodata);
        build/asm/3A680.s.o(.rodata);
        build/asm/3A790.s.o(.rodata);
        build/asm/3A7D0.s.o(.rodata);
        build/asm/3A830.s.o(.rodata);
        build/asm/3A980.s.o(.rodata);
        build/asm/3AA80.s.o(.rodata);
        build/asm/3B170.s.o(.rodata);
        build/asm/3B220.s.o(.rodata);
        build/asm/3B230.s.o(.rodata);
        build/asm/3C460.s.o(.rodata);
        build/asm/3C6B0.s.o(.rodata);
        build/asm/3C6F0.s.o(.rodata);
        build/asm/3D1B0.s.o(.rodata);
        build/asm/3D1F0.s.o(.rodata);
        build/asm/3D280.s.o(.rodata);
        build/asm/3D2C0.s.o(.rodata);
        build/asm/3D9D0.s.o(.rodata);
        build/asm/3DA70.s.o(.rodata);
        build/asm/3DA90.s.o(.rodata);
        build/asm/3DB20.s.o(.rodata);
        build/asm/3DB80.s.o(.rodata);
        build/asm/3DBD0.s.o(.rodata);
        build/asm/3DC30.s.o(.rodata);
        build/asm/3DC90.s.o(.rodata);
        build/asm/3DCF0.s.o(.rodata);
        build/asm/3E4D0.s.o(.rodata);
        build/asm/3E510.s.o(.rodata);
        build/asm/3E850.s.o(.rodata);
        build/asm/3E8C0.s.o(.rodata);
        build/asm/3EAA0.s.o(.rodata);
        build/asm/3EC80.s.o(.rodata);
        build/asm/3EE20.s.o(.rodata);
        build/asm/3F2A0.s.o(.rodata);
        build/asm/3F510.s.o(.rodata);
        build/asm/3F960.s.o(.rodata);
        build/asm/3F9C0.s.o(.rodata);
        build/asm/3FB90.s.o(.rodata);
        build/asm/3FBB0.s.o(.rodata);
        build/asm/3FC60.s.o(.rodata);
        build/asm/405B0.s.o(.rodata);
        build/asm/40610.s.o(.rodata);
        build/asm/40670.s.o(.rodata);
        build/asm/40710.s.o(.rodata);
        build/asm/40750.s.o(.rodata);
        build/asm/40870.s.o(.rodata);
        build/asm/40C60.s.o(.rodata);
        build/asm/41230.s.o(.rodata);
        build/asm/41240.s.o(.rodata);
        build/asm/41250.s.o(.rodata);
        build/asm/415A0.s.o(.rodata);
        build/asm/41630.s.o(.rodata);
        build/asm/41660.s.o(.rodata);
        build/asm/41A70.s.o(.rodata);
        build/asm/41D70.s.o(.rodata);
        build/asm/41D80.s.o(.rodata);
        build/asm/41E40.s.o(.rodata);
        build/asm/42B00.s.o(.rodata);
        build/asm/42BA0.s.o(.rodata);
        build/asm/42D20.s.o(.rodata);
        build/asm/42D30.s.o(.rodata);
        build/asm/43810.s.o(.rodata);
        build/asm/438B0.s.o(.rodata);
        build/asm/44550.s.o(.rodata);
        build/asm/44850.s.o(.rodata);
        build/asm/454B0.s.o(.rodata);
        build/asm/455C0.s.o(.rodata);
        build/asm/46FF0.s.o(.rodata);
        build/asm/470C0.s.o(.rodata);
        build/asm/47210.s.o(.rodata);
        build/asm/472A0.s.o(.rodata);
        build/asm/474D0.s.o(.rodata);
        build/asm/47610.s.o(.rodata);
        build/asm/476A0.s.o(.rodata);
        build/asm/47740.s.o(.rodata);
        build/asm/477D0.s.o(.rodata);
        build/asm/47AC0.s.o(.rodata);
        build/asm/47B40.s.o(.rodata);
        build/asm/47D70.s.o(.rodata);
        build/asm/488F0.s.o(.rodata);
        build/asm/49340.s.o(.rodata);
        build/asm/494B0.s.o(.rodata);
        build/asm/49700.s.o(.rodata);
        build/asm/497E0.s.o(.rodata);
        build/asm/49990.s.o(.rodata);
        build/asm/499C0.s.o(.rodata);
        build/asm/49AD0.s.o(.rodata);
        build/asm/49B30.s.o(.rodata);
        build/asm/49E60.s.o(.rodata);
        build/asm/49EB0.s.o(.rodata);
        build/asm/49F00.s.o(.rodata);
        build/asm/49F10.s.o(.rodata);
        build/asm/4A1B0.s.o(.rodata);
        build/asm/4AC70.s.o(.rodata);
        build/asm/4ACF0.s.o(.rodata);
        build/asm/4AD10.s.o(.rodata);
        build/asm/4B960.s.o(.rodata);
        build/asm/4C3F0.s.o(.rodata);
        main_RODATA_END = .;
        main_RODATA_SIZE = ABSOLUTE(main_RODATA_END - main_RODATA_START);
    }
    main_bss_VRAM = ADDR(.main_bss);
    .main_bss (NOLOAD) : SUBALIGN(16)
    {
        main_BSS_START = .;
        build/src/1000.c.o(.bss);
        build/src/1130.c.o(.bss);
        build/src/1870.c.o(.bss);
        build/src/3B40.c.o(.bss);
        build/src/3F50.c.o(.bss);
        build/src/9D50.c.o(.bss);
        build/src/DAE0.c.o(.bss);
        build/src/E2A0.c.o(.bss);
        build/src/113F0.c.o(.bss);
        build/src/13DE0.c.o(.bss);
        build/src/140D0.c.o(.bss);
        build/src/15150.c.o(.bss);
        build/src/17360.c.o(.bss);
        build/src/1B200.c.o(.bss);
        build/src/1E570.c.o(.bss);
        build/src/1FA00.c.o(.bss);
        build/src/20DA0.c.o(.bss);
        build/src/216E0.c.o(.bss);
        build/src/272D0.c.o(.bss);
        build/src/27600.c.o(.bss);
        build/src/27A90.c.o(.bss);
        build/src/28D20.c.o(.bss);
        build/src/29150.c.o(.bss);
        build/src/2B0F0.c.o(.bss);
        build/src/337B0.c.o(.bss);
        build/src/35EC0.c.o(.bss);
        build/src/363B0.c.o(.bss);
        build/src/36DB0.c.o(.bss);
        build/src/36E60.c.o(.bss);
        build/src/376C0.c.o(.bss);
        build/src/37980.c.o(.bss);
        build/src/37AD0.c.o(.bss);
        build/src/37E40.c.o(.bss);
        build/asm/37EB0.s.o(.bss);
        build/asm/37F20.s.o(.bss);
        build/asm/38060.s.o(.bss);
        build/asm/382C0.s.o(.bss);
        build/asm/382F0.s.o(.bss);
        build/asm/38680.s.o(.bss);
        build/asm/38770.s.o(.bss);
        build/asm/38A80.s.o(.bss);
        build/asm/38AF0.s.o(.bss);
        build/asm/38CB0.s.o(.bss);
        build/asm/38D30.s.o(.bss);
        build/asm/38DB0.s.o(.bss);
        build/asm/38E40.s.o(.bss);
        build/asm/39110.s.o(.bss);
        build/asm/39330.s.o(.bss);
        build/asm/39610.s.o(.bss);
        build/asm/39820.s.o(.bss);
        build/asm/39BA0.s.o(.bss);
        build/asm/39E30.s.o(.bss);
        build/asm/3A2C0.s.o(.bss);
        build/asm/3A360.s.o(.bss);
        build/asm/3A4D0.s.o(.bss);
        build/asm/3A550.s.o(.bss);
        build/asm/3A5D0.s.o(.bss);
        build/asm/3A680.s.o(.bss);
        build/asm/3A790.s.o(.bss);
        build/asm/3A7D0.s.o(.bss);
        build/asm/3A830.s.o(.bss);
        build/asm/3A980.s.o(.bss);
        build/asm/3AA80.s.o(.bss);
        build/asm/3B170.s.o(.bss);
        build/asm/3B220.s.o(.bss);
        build/asm/3B230.s.o(.bss);
        build/asm/3C460.s.o(.bss);
        build/asm/3C6B0.s.o(.bss);
        build/asm/3C6F0.s.o(.bss);
        build/asm/3D1B0.s.o(.bss);
        build/asm/3D1F0.s.o(.bss);
        build/asm/3D280.s.o(.bss);
        build/asm/3D2C0.s.o(.bss);
        build/asm/3D9D0.s.o(.bss);
        build/asm/3DA70.s.o(.bss);
        build/asm/3DA90.s.o(.bss);
        build/asm/3DB20.s.o(.bss);
        build/asm/3DB80.s.o(.bss);
        build/asm/3DBD0.s.o(.bss);
        build/asm/3DC30.s.o(.bss);
        build/asm/3DC90.s.o(.bss);
        build/asm/3DCF0.s.o(.bss);
        build/asm/3E4D0.s.o(.bss);
        build/asm/3E510.s.o(.bss);
        build/asm/3E850.s.o(.bss);
        build/asm/3E8C0.s.o(.bss);
        build/asm/3EAA0.s.o(.bss);
        build/asm/3EC80.s.o(.bss);
        build/asm/3EE20.s.o(.bss);
        build/asm/3F2A0.s.o(.bss);
        build/asm/3F510.s.o(.bss);
        build/asm/3F960.s.o(.bss);
        build/asm/3F9C0.s.o(.bss);
        build/asm/3FB90.s.o(.bss);
        build/asm/3FBB0.s.o(.bss);
        build/asm/3FC60.s.o(.bss);
        build/asm/405B0.s.o(.bss);
        build/asm/40610.s.o(.bss);
        build/asm/40670.s.o(.bss);
        build/asm/40710.s.o(.bss);
        build/asm/40750.s.o(.bss);
        build/asm/40870.s.o(.bss);
        build/asm/40C60.s.o(.bss);
        build/asm/41230.s.o(.bss);
        build/asm/41240.s.o(.bss);
        build/asm/41250.s.o(.bss);
        build/asm/415A0.s.o(.bss);
        build/asm/41630.s.o(.bss);
        build/asm/41660.s.o(.bss);
        build/asm/41A70.s.o(.bss);
        build/asm/41D70.s.o(.bss);
        build/asm/41D80.s.o(.bss);
        build/asm/41E40.s.o(.bss);
        build/asm/42B00.s.o(.bss);
        build/asm/42BA0.s.o(.bss);
        build/asm/42D20.s.o(.bss);
        build/asm/42D30.s.o(.bss);
        build/asm/43810.s.o(.bss);
        build/asm/438B0.s.o(.bss);
        build/asm/44550.s.o(.bss);
        build/asm/44850.s.o(.bss);
        build/asm/454B0.s.o(.bss);
        build/asm/455C0.s.o(.bss);
        build/asm/46FF0.s.o(.bss);
        build/asm/470C0.s.o(.bss);
        build/asm/47210.s.o(.bss);
        build/asm/472A0.s.o(.bss);
        build/asm/474D0.s.o(.bss);
        build/asm/47610.s.o(.bss);
        build/asm/476A0.s.o(.bss);
        build/asm/47740.s.o(.bss);
        build/asm/477D0.s.o(.bss);
        build/asm/47AC0.s.o(.bss);
        build/asm/47B40.s.o(.bss);
        build/asm/47D70.s.o(.bss);
        build/asm/488F0.s.o(.bss);
        build/asm/49340.s.o(.bss);
        build/asm/494B0.s.o(.bss);
        build/asm/49700.s.o(.bss);
        build/asm/497E0.s.o(.bss);
        build/asm/49990.s.o(.bss);
        build/asm/499C0.s.o(.bss);
        build/asm/49AD0.s.o(.bss);
        build/asm/49B30.s.o(.bss);
        build/asm/49E60.s.o(.bss);
        build/asm/49EB0.s.o(.bss);
        build/asm/49F00.s.o(.bss);
        build/asm/49F10.s.o(.bss);
        build/asm/4A1B0.s.o(.bss);
        build/asm/4AC70.s.o(.bss);
        build/asm/4ACF0.s.o(.bss);
        build/asm/4AD10.s.o(.bss);
        build/asm/4B960.s.o(.bss);
        build/asm/4C3F0.s.o(.bss);
        main_BSS_END = .;
        main_BSS_SIZE = ABSOLUTE(main_BSS_END - main_BSS_START);
    }
    __romPos += SIZEOF(.main);
    __romPos = ALIGN(__romPos, 16);
    main_ROM_END = __romPos;
    main_VRAM_END = .;

    _4C7B0_ROM_START = __romPos;
    _4C7B0_VRAM = ADDR(._4C7B0);
    ._4C7B0 : AT(_4C7B0_ROM_START) SUBALIGN(16)
    {
        _4C7B0_DATA_START = .;
        _4C7B0_bin = .;
        build/assets/4C7B0.bin.o(.data);
        _4C7B0_DATA_END = .;
        _4C7B0_DATA_SIZE = ABSOLUTE(_4C7B0_DATA_END - _4C7B0_DATA_START);
    }
    __romPos += SIZEOF(._4C7B0);
    _4C7B0_ROM_END = __romPos;
    _4C7B0_VRAM_END = .;

    /DISCARD/ :
    {
        *(*);
    }
}
